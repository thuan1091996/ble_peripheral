## CMakeLists.txt
```
# SPDX-License-Identifier: Apache-2.0

cmake_minimum_required(VERSION 3.20.0)

find_package(Zephyr REQUIRED HINTS $ENV{ZEPHYR_BASE})
project(hello_world)

target_sources(app PRIVATE src/main.c)
# Custom files and folders
target_sources(app PRIVATE
    src/ble/bluetoothle.c
)

zephyr_library_include_directories(src/ble)
```

## prj.conf
```kconfig
# Configure logger
CONFIG_LOG=y
CONFIG_LOG_BACKEND_RTT=y


# Configure debugger
CONFIG_THREAD_NAME=y
CONFIG_THREAD_ANALYZER=y
CONFIG_SEGGER_SYSTEMVIEW=y
CONFIG_USE_SEGGER_RTT=y
CONFIG_TRACING=y
CONFIG_TRACING_BACKEND_RAM=y
CONFIG_ASSERT=y

# Configure Bluetooth
CONFIG_BT=y
CONFIG_BT_PERIPHERAL=y
CONFIG_BT_DEVICE_NAME="Itachi-BLE"
CONFIG_BT_DEVICE_APPEARANCE=0
CONFIG_BT_MAX_CONN=1
CONFIG_BT_LL_SOFTDEVICE=y
```

## src/main.c
```c
/*
 * Copyright (c) 2012-2014 Wind River Systems, Inc.
 *
 * SPDX-License-Identifier: Apache-2.0
 */

#include <zephyr.h>
#include <logging/log.h>

#include "ble/bluetoothle.h"
#define MODULE_NAME			main_module
#define MODULE_LOG_LEVEL	LOG_LEVEL_DBG

LOG_MODULE_REGISTER(MODULE_NAME, MODULE_LOG_LEVEL);




/* BLE callbacks*/
static struct bt_conn  *current_conn;
static ble_gatt_cb_t	my_srv_callbacks;


void on_connected(struct bt_conn *conn, uint8_t err)
{
	if(err) {
		LOG_ERR("connection err: %d", err);
		return;
	}
	LOG_INF("Connected.");
	current_conn = bt_conn_ref(conn);
}

void on_disconnected(struct bt_conn *conn, uint8_t reason)
{
	LOG_INF("Disconnected (reason: %d)", reason);
	if(current_conn) {
		bt_conn_unref(current_conn);
		current_conn = NULL;
	}
}

struct bt_conn_cb ble_cb = {
	.connected 		= &on_connected,
	.disconnected 	= &on_disconnected,
};

void main(void)
{
	LOG_INF("BLE sample demo using %s", CONFIG_BOARD);
	ble_init(&ble_cb, &my_srv_callbacks);
}
```
